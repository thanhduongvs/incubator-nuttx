## boards/arm/imxrt/imxrt1052-thatico/Kconfig
```kconfig
#
# For a description of the syntax of this configuration file,
# see the file kconfig-language.txt in the NuttX tools repository.
#

if ARCH_BOARD_IMXRT1052_THATICO

choice
	prompt "Boot Flash"
	default IMXRT1052_THATICO_QSPI_FLASH

config IMXRT1052_THATICO_HYPER_FLASH
	bool "HYPER Flash"

config IMXRT1052_THATICO_QSPI_FLASH
	bool "QSPI Flash"

endchoice # Boot Flash

config IMXRT1052_THATICO_SDRAM
	bool "Enable SDRAM"
	default n
	select IMXRT_SEMC_INIT_DONE
	---help---
		Activate DCD configuration of SDRAM

endif
```
